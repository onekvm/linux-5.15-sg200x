## drivers/soc/sophgo/Kconfig
```kconfig
# SPDX-License-Identifier: GPL-2.0-only
#
# Sophgo SoC drivers
#

menu "Sophgo SoC drivers"

config SOPHGO_CV1800_RTCSYS
	tristate "Sophgo CV1800 RTC MFD"
	depends on OF
	select MFD_CORE
	help
	  If you say yes here you get support for the RTC MFD driver for
	  Sophgo CV1800 series SoCs. The RTC module comprises a 32kHz
	  oscillator, Power-on-Reset sub-module and the hardware state
	  machine controlling chip power-on, power-off and reset.

	  This driver can also be built as a module. If so, the module will
	  be called cv1800-rtcsys.

endmenu
```
